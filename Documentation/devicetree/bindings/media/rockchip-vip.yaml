## drivers/cpuidle/Kconfig
```kconfig
menuconfig CPU_IDLE
	bool "CPU idle PM support"
	default y if ACPI || PPC_PSERIES
	select CPU_IDLE_GOV_LADDER if (!NO_HZ && !NO_HZ_IDLE)
	select CPU_IDLE_GOV_MENU if (NO_HZ || NO_HZ_IDLE)
	help
	  CPU idle is a generic framework for supporting software-controlled
	  idle processor power management.  It includes modular cross-platform
	  governors that can be swapped during runtime.

	  If you're using an ACPI-enabled platform, you should say Y here.

if CPU_IDLE

config CPU_IDLE_MULTIPLE_DRIVERS
        bool "Support multiple cpuidle drivers"
        default n
        help
         Allows the cpuidle framework to use different drivers for each CPU.
         This is useful if you have a system with different CPU latencies and
         states. If unsure say N.

config CPU_IDLE_GOV_LADDER
	bool "Ladder governor (for periodic timer tick)"
	default y

config CPU_IDLE_GOV_MENU
	bool "Menu governor (for tickless system)"
	default y

config ARCH_NEEDS_CPU_IDLE_COUPLED
	def_bool n

config EXYNOS_CPUIDLE_C2
	bool "EXYNOS CPUIDLE C2"
	depends on CPU_IDLE
	default y
	help
	  Enable C2 state on cpuidle

config EXYNOS_CLUSTER_POWER_DOWN
	bool "EXYNOS CLUSTER POWER DOWN"
	depends on EXYNOS_CPUIDLE_C2
	help
	  Enable C2 state on cpuidle

config CPUIDLE_TEST_SYSFS
	bool "Enable C2 sysfs"
	depends on EXYNOS_CPUIDLE_C2
	help
	  Enable sysfs interface to check C2 status

config EXYNOS_IDLE_CLOCK_DOWN
	bool "EXYNOS core idle clock down"
	depends on CPU_IDLE
	default y
	help
	  Enable core idle clock down

if CPU_IDLE

config CPU_IDLE_CALXEDA
	bool "CPU Idle Driver for Calxeda processors"
	depends on ARCH_HIGHBANK
	select ARM_CPU_SUSPEND
	help
	  Select this to enable cpuidle on Calxeda processors.

config CPU_IDLE_ZYNQ
	bool "CPU Idle Driver for Xilinx Zynq processors"
	depends on ARCH_ZYNQ
	help
	  Select this to enable cpuidle on Xilinx Zynq processors.

endif

config ARCH_NEEDS_CPU_IDLE_COUPLED
	def_bool n
```
