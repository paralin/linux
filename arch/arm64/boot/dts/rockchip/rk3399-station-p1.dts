// SPDX-License-Identifier: (GPL-2.0+ OR MIT)
/*
 * Copyright (c) 2019 Fuzhou Rockchip Electronics Co., Ltd
 * Copyright (c) 2019 Radxa Limited
 * Copyright (c) 2019 Amarula Solutions(India)
 */

/dts-v1/;
#include "rk3399-rock-pi-4.dtsi"

/ {
	model = "Firefly Station P1";
	compatible = "radxa,rockpi4c", "radxa,rockpi4", "rockchip,rk3399";
};
